## ArkPro Reference/kernel/drivers/ark/audio/Kconfig
```kconfig
#
# Audio Kconfig
#

menu "ALSA audio controller support"

comment "Sound card support - ALSA is needed"

config SND_ARK_SOC
	tristate "SoC Audio for the ARK SoC"
	depends on SND_SOC
	help
		Say Y or M if you want to add support for codecs attached to the
		ARK interface. You will also need to select the audio interfaces
		to support below.

config SND_ARK_SOC_DMA
	tristate "SOC DMA set for Audio"
	depends on SND_ARK_SOC
	select SND_SOC_DMAENGINE_PCM

config SND_ARK_SOC_I2S
	tristate "I2S driver for Audio"
	depends on SND_ARK_SOC

config SND_SDDAC
	tristate "DAC for Audio out"
	depends on SND_ARK_SOC

config SND_ARK_SOC_ARK_CS4270
	tristate "SoC Audio support for CS4270-based board"
	depends on SND_ARK_SOC && ARK_AHB_DW_DMAC
	select SND_ARK_SOC_DMA
	select SND_ARK_SOC_I2S
	select SND_SOC_CS4270
	help
		Say Y if you want to add ALSA sound driver for 
		CS4270-based board.

config SND_ARK_SOC_ARK_SDDAC
	tristate "SoC Audio support for Arkmicro SDDAC"
	depends on SND_ARK_SOC && ARK_AHB_DW_DMAC
	select SND_ARK_SOC_DMA
	select SND_ARK_SOC_I2S
	select SND_ARK_SDDAC
	help
		Say Y if you want to add ALSA aound driver for 
		Arkmicro SDDAC
config FM1288_Driver
	tristate "FM1288_Driver"
	help
		Say Y if you want to add ALSA FM1288_Driver 

endmenu
```

## ArkPro Reference/kernel/drivers/ark/display/Kconfig
```kconfig
#
# ArkMicro on-chip display control unit drivers configuration
#

menuconfig ARK_DISP
	tristate "ArkMicro Display Control Support"
	default y
        select RINGPAIR
        select MEDIA_SUPPORT
        select FB_SYS_FILLRECT
        select FB_SYS_COPYAREA
        select FB_SYS_IMAGEBLIT
        select FB_CFB_FILLRECT
        select FB_CFB_COPYAREA
        select FB_CFB_IMAGEBLIT
        select FB_SYS_FOPS
        select VIDEO_DEV
        select VIDEO_V4L2
        select VIDEO_V4L1
        select VIDEO_V4L2_COMMON
        select V4L2_MEM2MEM_DRIVERS
        select VIDEOBUF_DMA_SG
        select VIDEOBUF_GEN
        select VIDEOBUF_DMA_CONTIG
        select VIDEOBUF_VMALLOC
	help
	  Say y here to enable ArkMicro display control driver.

if ARK_DISP

config ARK_DISP_DEBUG
	bool "Enable driver debug mode"
	default y
	depends on ARK_DISP
	help
	  Say y here to enable ArkMicro display control driver
	  debug mode (to print debug kernel messages).

config ARK_DISP_HW_EMULATION
	bool "Enable display control unit hardware emulation support"
	depends on ARK_DISP
	help
	  Say y here to enable ArkMicro display control hardware
	  emulation (for testing).

config ARK_DISP_OUTPUT_EMULATION
	bool "Enable output stage device (i.e. deinterlacer) emulation support"
	depends on ARK_DISP
	help
	  Say y here to enable ArkMicro output stage device emulation 
          (for testing).


endif # ARK_DISP
```

## ArkPro Reference/kernel/drivers/ark/pwm/Kconfig
```kconfig
#
# ArkMicro on-chip pulse width modualtion control driver configuration
#

menuconfig ARK_PWM
	tristate "ArkMicro PWM Control Support"
	default y
	help
	  Say y here to enable ArkMicro pwm control driver.

if ARK_PWM

config ARK_PWM_DEBUG
	bool "Enable driver debug mode"
	depends on ARK_PWM
	help
	  Say y here to enable ArkMicro pwm control driver
	  debug mode (to print debug kernel messages).

config ARK_PWM_HW_EMULATION
        bool "Enable pwm control unit hardware emulation support"
        depends on ARK_PWM
        help
          Say y here to enable ArkMicro pwm control hardware
          emulation (for testing).


endif # ARK_PWM
```
